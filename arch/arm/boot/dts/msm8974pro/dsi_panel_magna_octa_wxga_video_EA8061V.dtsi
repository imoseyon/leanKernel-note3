/* Copyright (c) 2012, Samsung Electronics Corporation. All rights reserved.
 *
 * This program is free software; you can redistribute it and/or modify
 * it under the terms of the GNU General Public License version 2 and
 * only version 2 as published by the Free Software Foundation.
 *
 * This program is distributed in the hope that it will be useful,
 * but WITHOUT ANY WARRANTY; without even the implied warranty of
 * MERCHANTABILITY or FITNESS FOR A PARTICULAR PURPOSE.  See the
 * GNU General Public License for more details.
 */

&mdss_mdp {
	dsi_magna_octa_wxga_dual:mdss_dsi_magna_wxga_video_dual {
		qcom,mdss-dsi-panel-name = "samsung,mdss-amoled-dsi-panel";
		label = "samsung amoled wxga video mode dsi EA8061V panel";
		status = "disable";
		qcom,mdss-dsi-panel-controller = <&mdss_dsi0>;

		qcom,rst-gpio = <&pma8084_gpios 17 0>;
		/* samsung,expander-enable-gpio = <&expander_gpios 10 0>; */
		qcom,esd-irq-gpio = <&pma8084_gpios 4 0>;
		qcom,lcd-crack-det-gpio = <&msmgpio 64 0>;
		qcom,lcd-sel-gpio = <&msmgpio 57 0>;

		qcom,mdss-pan-clk-rate=<500000000>;

		qcom,mdss-pan-res = <768 1280>; /* wxga */
		qcom,mdss-pan-size = <60 106>; /* <Width> <Height> real size of panel in mm */
		qcom,mdss-pan-bpp = <24>;
		qcom,mdss-pan-dest = "display_1";
		qcom,mdss-pan-porch-values = <100 96 100 8 2 14>; /* <HBP> <HPW> <HFP> <VBP> <VPW> <VFP> */
		qcom,mdss-pan-underflow-clr = <0xff>;
		qcom,mdss-pan-bl-ctrl = "bl_ctrl_dcs_cmds";
		qcom,mdss-pan-bl-levels = <1 255>;
		qcom,mdss-pan-dsi-mode = <0>;
		qcom,mdss-pan-dsi-h-pulse-mode = <0>;
		qcom,mdss-pan-dsi-h-power-stop = <0 0 0>;
		qcom,mdss-pan-dsi-bllp-power-stop = <1 1>;
		qcom,mdss-pan-dsi-traffic-mode = <2>;
		qcom,mdss-pan-dsi-dst-format = <3>;
		qcom,mdss-pan-dsi-vc = <0>;
		qcom,mdss-pan-dsi-rgb-swap = <0>;
		qcom,mdss-force-clk-lane-hs = <1>;
		samsung,mdss-early-lcd-on = <0>;
		qcom,mdss-pan-dsi-data-lanes = <1 1 1 1>;
		qcom,mdss-pan-dsi-dlane-swap = <0>;
		qcom,mdss-pan-dsi-t-clk = <0x34 0x04>;
		qcom,mdss-pan-dsi-stream = <0>;
		qcom,mdss-pan-dsi-mdp-tr = <0x0>;
		qcom,mdss-pan-dsi-dma-tr = <0x04>;
		qcom,mdss-pan-dsi-tx-eot-append = <1>;
		qcom,mdss-pan-dsi-frame-rate = <60>;
		qcom,cont-splash-enabled;

		qcom,panel-phy-regulatorSettings =
							[07 09 03 00 20 00 01]; /* Regualotor settings */
		qcom,panel-phy-timingSettings =
							[8B 1E 14 00 44 4A 28 35 29 03 04 00];
		qcom,panel-phy-strengthCtrl = [ff 06];
		qcom,panel-phy-bistCtrl =
							[00 00 b1 ff 00 00];	/*!!!! BIST Ctrl settings */
		qcom,panel-phy-laneConfig = [
		00 00 00 00 00 00 00 01 97 /* lane0 config */
		00 00 00 00 05 00 00 01 97 /* lane1 config */
		00 00 00 00 0a 00 00 01 97 /* lane2 config */
		00 00 00 00 0f 00 00 01 97 /* lane3 config */
		00 c0 00 00 00 00 00 01 bb]; /* Clk ln config */

		qcom,panel-display-on-seq = [
					39 00 00 00 00 00 03 F0 5A 5A
					39 00 00 00 00 00 03 F1 5A 5A

					/* 1. Common Setting */

					39 00 00 00 00 00 03 B8 00 00	/* TSET:25'c , Vlin1 : 7.0V */
					39 00 00 00 00 00 02 BA 56
					39 00 00 00 00 00 03 FC 5A 5A
					39 00 00 00 00 00 02 B0 0B
					39 00 00 00 00 00 03 D2 00 85
					39 00 00 00 00 00 02 B0 05
					39 00 00 00 00 00 02 FE 0C
					39 00 00 00 00 00 03 FC A5 A5

					/* 2. Brightness Control */

					39 00 00 00 00 00 22
						CA 01 00 01 00 01 00 80
						80 80 80 80 80 80 80 80
						80 80 80 80 80 80 80 80
						80 80 80 80 80 80 80 00
						00 00
					39 00 00 00 00 00 05 B2 00 06 00 0B
					39 00 00 00 00 00 03 B6 5C 8A	/* MPS/ELVSS setting */
					39 00 00 00 00 00 02 F7 01

					39 00 00 00 00 00 02 B5 21	/* 16 frame Averging */
					39 00 00 00 00 00 02 55 00	/* ACL2 OFF */
					39 00 00 00 00 00 02 F7 01

					/* H sync */
					39 00 00 00 00 00 02 B9 05

					/* 3. ELVSS Control */

					/* 4. ETC condition set */

					39 00 00 00 78 00 02 11 00	/* sleep out */
												/* wait 120ms(0x78) */

					39 00 00 00 00 00 03 F0 A5 A5
					39 01 00 00 00 00 03 F1 A5 A5
					];
		qcom,on-cmds-dsi-state = "DSI_HS_MODE";
		qcom,panel-display-off-seq = [
				05 00 00 00 24 00 02 28 00			/* wait 40ms(0x24) */
				05 01 00 00 78 00 02 10 00			/* wait 120ms(0x78) */
			];
		qcom,off-cmds-dsi-state = "DSI_HS_MODE";

			samsung,panel-test-key-enable-cmds 	= [ 39 00 00 00 00 00 03 F0 5A 5A];
			samsung,panel-test-key-disable-cmds = [ 39 01 00 00 00 00 03 F0 A5 A5];

			samsung,panel-nv-mtp-read-cmds = [ 06 01 00 00 00 00 01 c8 21 00];
			samsung,panel-nv-mtp-read-hbm-cmds = [ 06 01 00 00 00 00 01 c8 07 21];	/* read C8 34~40th , 33=0x21*/
			samsung,panel-nv-mtp-read-hbm2-cmds = [ 06 01 00 00 00 00 01 c8 0F 2A];	/* read C8 43~57th , 42=0x2A*/
			samsung,panel-nv-mdnie-read-cmds = [ 06 01 00 00 00 00 01 A1 04 00];
			samsung,panel-nv-read-cmds = [ 06 01 00 00 00 00 01 c8 21 00];
			samsung,panel-nv-read-enable-cmds = [
								39 00 00 00 00 00 03 f0 5a 5a
								39 00 00 00 00 00 03 fc 5a 5a
								39 01 00 00 00 00 03 f1 5a 5a];
			samsung,panel-nv-read-disable-cmds = [ 39 01 00 00 00 00 03 f0 a5 a5 ];

			samsung,panel-mtp-read-sysfs-cmds = [ 06 01 00 00 00 00 01 00 00 00];

			samsung,panel-temp-read-cmd = [06 00 00 00 00 00 01 c8 01 00];

			/* the last byte in all read commands will represent READ LENGH */
			samsung,panel-manufacture-id-read-cmds = [
								06 00 00 00 00 00 01 da 01 00
								06 00 00 00 00 00 01 db 01 00
								06 01 00 00 00 00 01 dc 01 00];

			samsung,panel-manufacture-date-read-cmds = [ 06 01 00 00 00 00 01 c8 02 28];	/* read C8 41~42th , 40=0x28*/
			samsung,panel-ddi-id-read-cmds = [ 06 01 00 00 00 00 01 d6 05 00];	/* read D6 1~5th */

			samsung,panel-rddpm-read-cmds = [ 06 01 00 00 00 00 01 0A 01 00];	/* read 0A 1st */

			qcom,panel-display-on-cmds = [39 01 00 00 00 00 02 29 00];
			qcom,panel-display-off-cmds = [39 01 00 00 32 00 02 28 00];

			qcom,panel-display-unblank-cmds = [39 01 00 00 32 00 02 13 00];			/*Normal mode command*/
			qcom,panel-display-blank-cmds = [39 01 00 00 45 00 02 22 00];		 /* All pixel off - for making display black*/

			samsung,panel-acl-off-cmds = [39 00 00 00 72 00 02 55 00];

			samsung,panel-gamma-cmds-list = [39 00 00 00 00 00 22            /* Brightness Condition Set - Gamma 2.2 Setting*/
						ca 01 00 01 00 01 00 80
						80 80 80 80 80 80 80 80
						80 80 80 80 80 80 80 80
						80 80 80 80 80 80 80 00
						00 00
					39 00 00 00 00 00 02 F7 01 /* Gamma, LTPS(AID) update */
				];

			samsung,panel-gamma-hbm-cmds-list = [39 00 00 00 00 00 22            /* Brightness Condition Set - Gamma 2.2 Setting*/
						ca 01 00 01 00 01 00 80
						80 80 80 80 80 80 80 80
						80 80 80 80 80 80 80 80
						80 80 80 80 80 80 80 00
						00 00
				];
			samsung,panel-etc-hbm-cmds = [
					39 00 00 00 00 00 05 B2 00 06 00 0B	/* samsung_brightness_aor_condition */
					39 00 00 00 00 00 03 b6 48 8A 	/* ELVSS  */
					39 00 00 00 00 00 02 B0 03		/* global para */
					39 00 00 00 00 00 02 B6 00		/* C8h 40th - MPS / ELVSS setting */
					39 00 00 00 00 00 02 B5 29		/* OPR Average Calculation */
					39 00 00 00 00 00 02 55 01	   	/* power saving Set 15 % */
					39 00 00 00 00 00 02 F7 01		/* Gamma, LTPS(AID) update */
				];

			/*
			 * ************************************************************************************************************************
			 * AID command list and mappings
			 * ************************************************************************************************************************
			 */
			samsung,panel-aid-cmds-list = [
				39 00 00 00 00 00 05 B2 00 06 04 DF /* 0 samsung_brightness */
				39 00 00 00 00 00 05 B2 00 06 04 D3 /* 1 samsung_brightness */
				39 00 00 00 00 00 05 B2 00 06 04 C7 /* 2 samsung_brightness */
				39 00 00 00 00 00 05 B2 00 06 04 BD /* 3 samsung_brightness */
				39 00 00 00 00 00 05 B2 00 06 04 B1 /* 4 samsung_brightness */
				39 00 00 00 00 00 05 B2 00 06 04 A5 /* 5 samsung_brightness */
				39 00 00 00 00 00 05 B2 00 06 04 98 /* 6 samsung_brightness */
				39 00 00 00 00 00 05 B2 00 06 04 8E /* 7 samsung_brightness */
				39 00 00 00 00 00 05 B2 00 06 04 83 /* 8 samsung_brightness */
				39 00 00 00 00 00 05 B2 00 06 04 76 /* 9 samsung_brightness */
				39 00 00 00 00 00 05 B2 00 06 04 6A /* 10 samsung_brightness */
				39 00 00 00 00 00 05 B2 00 06 04 5F /* 11 samsung_brightness */
				39 00 00 00 00 00 05 B2 00 06 04 52 /* 12 samsung_brightness */
				39 00 00 00 00 00 05 B2 00 06 04 3B /* 13 samsung_brightness */
				39 00 00 00 00 00 05 B2 00 06 04 2E /* 14 samsung_brightness */
				39 00 00 00 00 00 05 B2 00 06 04 24 /* 15 samsung_brightness */
				39 00 00 00 00 00 05 B2 00 06 04 19 /* 16 samsung_brightness */
				39 00 00 00 00 00 05 B2 00 06 04 00 /* 17 samsung_brightness */
				39 00 00 00 00 00 05 B2 00 06 03 F4 /* 18 samsung_brightness */
				39 00 00 00 00 00 05 B2 00 06 03 DC /* 19 samsung_brightness */
				39 00 00 00 00 00 05 B2 00 06 03 C4 /* 20 samsung_brightness */
				39 00 00 00 00 00 05 B2 00 06 03 B8 /* 21 samsung_brightness */
				39 00 00 00 00 00 05 B2 00 06 03 A0 /* 22 samsung_brightness */
				39 00 00 00 00 00 05 B2 00 06 03 88 /* 23 samsung_brightness */
				39 00 00 00 00 00 05 B2 00 06 03 66 /* 24 samsung_brightness */
				39 00 00 00 00 00 05 B2 00 06 03 4D /* 25 samsung_brightness */
				39 00 00 00 00 00 05 B2 00 06 03 36 /* 26 samsung_brightness */
				39 00 00 00 00 00 05 B2 00 06 03 10 /* 27 samsung_brightness */
				39 00 00 00 00 00 05 B2 00 06 02 ED /* 28 samsung_brightness */
				39 00 00 00 00 00 05 B2 00 06 02 C8 /* 29 samsung_brightness */
				39 00 00 00 00 00 05 B2 00 06 02 A2 /* 30 samsung_brightness */
				39 00 00 00 00 00 05 B2 00 06 02 7F /* 31 samsung_brightness */
				39 00 00 00 00 00 05 B2 00 06 02 4E /* 32 samsung_brightness */
				39 00 00 00 00 00 05 B2 00 06 02 1A /* 33 samsung_brightness */
				39 00 00 00 00 00 05 B2 00 06 01 E3 /* 34 samsung_brightness */
				39 00 00 00 00 00 05 B2 00 06 01 E3 /* 35 samsung_brightness */
				39 00 00 00 00 00 05 B2 00 06 01 AC /* 36 samsung_brightness */
				39 00 00 00 00 00 05 B2 00 06 01 70 /* 37 samsung_brightness */
				39 00 00 00 00 00 05 B2 00 06 01 2D /* 38 samsung_brightness */
				39 00 00 00 00 00 05 B2 00 06 00 E9 /* 39 samsung_brightness */
				39 00 00 00 00 00 05 B2 00 06 00 A2 /* 40 samsung_brightness */
				39 00 00 00 00 00 05 B2 00 06 00 57 /* 41 samsung_brightness */
				39 00 00 00 00 00 05 B2 00 06 00 08 /* 42 samsung_brightness */
			];

			/* bl_level, Index in acl command list */
			samsung,panel-aid-map-table = <
					5    0         6    1        7    2        8    3      9    4
					10   5         11   6        12   7       13   8     14   9
					15   10        16   11       17   12       19   13     20   14
					21   15        22   16       24   17       25   18     27   19
					29   20        30   21       32   22       34   23     37   24
					39   25        41   26       44   27       47   28     50   29
					53   30        56   31       60   32       64   33     68   34
					72   34        77   34       82   34       87   34     93   34
					98   34        105  34       111  34       119  34     126  34
					134  34        143  34       152  34       162  35     172  36
					183  37        195  38       207  39       220  40     234  41
					249  42        265  42       282  42       300  42     316  42
					333  42        350  42
				>;

			/*
			 * ************************************************************************************************************************
			 * ACL command list and mappings
			 * ************************************************************************************************************************
			 */
			 /* B5h
 			   * 1st - 0x01 : PSRE , 0x03 : no PSRE
			   * 2nd(OPR) - 0x99 : 60%
 			   * 3rd(ACL) - 0x23 : 27.6% , 0x27 : 30%, 0x35 : 40%
 			   */
			samsung,panel-aclcont-cmds-list = [
					39 00 00 00 00 00 02 B5 29	/* 32 frame Averaging */
			 ];
			samsung,panel-acl-cmds-list = [
					39 00 00 00 00 00 02 55 00 /* 0 */
					39 00 00 00 00 00 02 55 01 /* 1 */
					39 00 00 00 00 00 02 55 02 /* 2 */
					39 00 00 00 00 00 02 55 03]; /* 3 */
			/* bl_level , Index in acl command list */
			samsung,panel-acl-map-table =  <
					2    1         3    1        4    1
					5    1         6    1        7    1         8    1      9    1
					10   1         11   1        12   1         13   1      14   1
					15   1         16   1        17   1         19   1      20   1
					21   1         22   1        24   1         25   1      27   1
					29   1         30   1        32   1         34   1      37   1
					39   1         41   1        44   1         47   1      50   1
					53   1         56   1        60   1         64   1      68   1
					72   1         77   1        82   1         87   1      93   1
					98   1         105  1        111  1         119  1      126  1
					134  1         143  1        152  1         162  1      172  1
					183  1         195  1        207  1         220  1      234  1
					249  1         265  1        282  1         300  1      316  1
					333  1         350  1
				>;

			/*
			 * ************************************************************************************************************************
			 * ELVSS command list and mappings
			 * ************************************************************************************************************************
			 */


			samsung,panel-elvss-common-cmds-list = [
							29 01 00 00 00 00 02 B8 00
							29 01 00 00 00 00 03 B6 00 00];

			samsung,panel-smart-elvss-hightemp-cmds-list = [
					29 01 00 00 00 00 03 b6 00 8A /* 0	350 */
					29 01 00 00 00 00 03 b6 00 8B /* 1	333 */
					29 01 00 00 00 00 03 b6 00 8B /* 2	316 */
					29 01 00 00 00 00 03 b6 00 8C /* 3	300 */
					29 01 00 00 00 00 03 b6 00 8C /* 4	282 */
					29 01 00 00 00 00 03 b6 00 8D /* 5	265 */
					29 01 00 00 00 00 03 b6 00 8E /* 6	249 */
					29 01 00 00 00 00 03 b6 00 8F /* 7	234 */
					29 01 00 00 00 00 03 b6 00 8F /* 8	220 */
					29 01 00 00 00 00 03 b6 00 8F /* 9	207 */
					29 01 00 00 00 00 03 b6 00 8F /* 10	195 */
					29 01 00 00 00 00 03 b6 00 8F /* 11 183 */
					29 01 00 00 00 00 03 b6 00 8F /* 12	172 */
					29 01 00 00 00 00 03 b6 00 8F /* 13	162 */
					29 01 00 00 00 00 03 b6 00 8F /* 14	152 */
					29 01 00 00 00 00 03 b6 00 90 /* 15	143 */
					29 01 00 00 00 00 03 b6 00 91 /* 16	134 */
					29 01 00 00 00 00 03 b6 00 91 /* 17	126 */
					29 01 00 00 00 00 03 b6 00 92 /* 18	119 */
					29 01 00 00 00 00 03 b6 00 92 /* 19	111 */
					29 01 00 00 00 00 03 b6 00 93 /* 20	105 */
					29 01 00 00 00 00 03 b6 00 93 /* 21	 98 */
					29 01 00 00 00 00 03 b6 00 94 /* 22	 92 */
					29 01 00 00 00 00 03 b6 00 94 /* 23	 88 */
					29 01 00 00 00 00 03 b6 00 94 /* 24	 82 */
					29 01 00 00 00 00 03 b6 00 95 /* 25	 77 */
					29 01 00 00 00 00 03 b6 00 95 /* 26	 72~5 */
				];

			samsung,panel-smart-elvss-zero-cmds-list = [
					29 01 00 00 00 00 03 b6 00 8A /* 350 */
					29 01 00 00 00 00 03 b6 00 8B /* 333 */
					29 01 00 00 00 00 03 b6 00 8B /* 316 */
					29 01 00 00 00 00 03 b6 00 8C /* 300 */
					29 01 00 00 00 00 03 b6 00 8D /* 282 */
					29 01 00 00 00 00 03 b6 00 8E /* 265 */
					29 01 00 00 00 00 03 b6 00 8E /* 249 */
					29 01 00 00 00 00 03 b6 00 8F /* 234 */
					29 01 00 00 00 00 03 b6 00 9F /* 220 */
					29 01 00 00 00 00 03 b6 00 90 /* 207 */
					29 01 00 00 00 00 03 b6 00 90 /* 195 */
					29 01 00 00 00 00 03 b6 00 90 /* 183 */
					29 01 00 00 00 00 03 b6 00 90 /* 172 */
					29 01 00 00 00 00 03 b6 00 90 /* 162 */
					29 01 00 00 00 00 03 b6 00 91 /* 152 */
					29 01 00 00 00 00 03 b6 00 92 /* 143 */
					29 01 00 00 00 00 03 b6 00 92 /* 134 */
					29 01 00 00 00 00 03 b6 00 93 /* 126 */
					29 01 00 00 00 00 03 b6 00 93 /* 119 */
					29 01 00 00 00 00 03 b6 00 94 /* 111 */
					29 01 00 00 00 00 03 b6 00 94 /* 105 */
					29 01 00 00 00 00 03 b6 00 95 /* 98 */
					29 01 00 00 00 00 03 b6 00 95 /* 92 */
					29 01 00 00 00 00 03 b6 00 96 /* 88 */
					29 01 00 00 00 00 03 b6 00 96 /* 82 */
					29 01 00 00 00 00 03 b6 00 96 /* 77 */
					29 01 00 00 00 00 03 b6 00 97 /* 72~5 */
				];

			samsung,panel-smart-acl-hightemp-cmds-list = [
					29 01 00 00 00 00 03 b6 00 8A /* 0	350 */
					29 01 00 00 00 00 03 b6 00 8B /* 1	333 */
					29 01 00 00 00 00 03 b6 00 8B /* 2	316 */
					29 01 00 00 00 00 03 b6 00 8C /* 3	300 */
					29 01 00 00 00 00 03 b6 00 8C /* 4	282 */
					29 01 00 00 00 00 03 b6 00 8D /* 5	265 */
					29 01 00 00 00 00 03 b6 00 8E /* 6	249 */
					29 01 00 00 00 00 03 b6 00 8F /* 7	234 */
					29 01 00 00 00 00 03 b6 00 8F /* 8	220 */
					29 01 00 00 00 00 03 b6 00 8F /* 9	207 */
					29 01 00 00 00 00 03 b6 00 8F /* 10	195 */
					29 01 00 00 00 00 03 b6 00 8F /* 11 183 */
					29 01 00 00 00 00 03 b6 00 8F /* 12	172 */
					29 01 00 00 00 00 03 b6 00 8F /* 13	162 */
					29 01 00 00 00 00 03 b6 00 8F /* 14	152 */
					29 01 00 00 00 00 03 b6 00 90 /* 15	143 */
					29 01 00 00 00 00 03 b6 00 91 /* 16	134 */
					29 01 00 00 00 00 03 b6 00 91 /* 17	126 */
					29 01 00 00 00 00 03 b6 00 92 /* 18	119 */
					29 01 00 00 00 00 03 b6 00 92 /* 19	111 */
					29 01 00 00 00 00 03 b6 00 93 /* 20	105 */
					29 01 00 00 00 00 03 b6 00 93 /* 21	 98 */
					29 01 00 00 00 00 03 b6 00 94 /* 22	 92 */
					29 01 00 00 00 00 03 b6 00 94 /* 23	 88 */
					29 01 00 00 00 00 03 b6 00 94 /* 24	 82 */
					29 01 00 00 00 00 03 b6 00 95 /* 25	 77 */
					29 01 00 00 00 00 03 b6 00 95 /* 26	 72~5 */
				];

			samsung,panel-smart-acl-zero-cmds-list = [
					29 01 00 00 00 00 03 b6 00 8A /* 350 */
					29 01 00 00 00 00 03 b6 00 8B /* 333 */
					29 01 00 00 00 00 03 b6 00 8B /* 316 */
					29 01 00 00 00 00 03 b6 00 8C /* 300 */
					29 01 00 00 00 00 03 b6 00 8D /* 282 */
					29 01 00 00 00 00 03 b6 00 8E /* 265 */
					29 01 00 00 00 00 03 b6 00 8E /* 249 */
					29 01 00 00 00 00 03 b6 00 8F /* 234 */
					29 01 00 00 00 00 03 b6 00 9F /* 220 */
					29 01 00 00 00 00 03 b6 00 90 /* 207 */
					29 01 00 00 00 00 03 b6 00 90 /* 195 */
					29 01 00 00 00 00 03 b6 00 90 /* 183 */
					29 01 00 00 00 00 03 b6 00 90 /* 172 */
					29 01 00 00 00 00 03 b6 00 90 /* 162 */
					29 01 00 00 00 00 03 b6 00 91 /* 152 */
					29 01 00 00 00 00 03 b6 00 92 /* 143 */
					29 01 00 00 00 00 03 b6 00 92 /* 134 */
					29 01 00 00 00 00 03 b6 00 93 /* 126 */
					29 01 00 00 00 00 03 b6 00 93 /* 119 */
					29 01 00 00 00 00 03 b6 00 94 /* 111 */
					29 01 00 00 00 00 03 b6 00 94 /* 105 */
					29 01 00 00 00 00 03 b6 00 95 /* 98 */
					29 01 00 00 00 00 03 b6 00 95 /* 92 */
					29 01 00 00 00 00 03 b6 00 96 /* 88 */
					29 01 00 00 00 00 03 b6 00 96 /* 82 */
					29 01 00 00 00 00 03 b6 00 96 /* 77 */
					29 01 00 00 00 00 03 b6 00 97 /* 72~5 */
				];

			samsung,panel-elvss-lowtemp-cmds-list = [
							29 01 00 00 00 00 02 B0 03
							29 01 00 00 00 00 02 B6 00];		/* Low Temperature Command */

			samsung,panel-smart-elvss-lowtemp-cmds-list = [
					29 01 00 00 00 00 02 b6 25 /* 350 */
					29 01 00 00 00 00 02 b6 24 /* 333 */
					29 01 00 00 00 00 02 b6 24 /* 316 */
					29 01 00 00 00 00 02 b6 23 /* 300 */
					29 01 00 00 00 00 02 b6 23 /* 282 */
					29 01 00 00 00 00 02 b6 22 /* 265 */
					29 01 00 00 00 00 02 b6 21 /* 249 */
					29 01 00 00 00 00 02 b6 20 /* 234 */
					29 01 00 00 00 00 02 b6 20 /* 220 */
					29 01 00 00 00 00 02 b6 20 /* 207 */
					29 01 00 00 00 00 02 b6 20 /* 195 */
					29 01 00 00 00 00 02 b6 20 /* 183 */
					29 01 00 00 00 00 02 b6 20 /* 172 */
					29 01 00 00 00 00 02 b6 20 /* 162 */
					29 01 00 00 00 00 02 b6 20 /* 152 */
					29 01 00 00 00 00 02 b6 00 /* 143 */
					29 01 00 00 00 00 02 b6 01 /* 134 */
					29 01 00 00 00 00 02 b6 01 /* 126 */
					29 01 00 00 00 00 02 b6 02 /* 119 */
					29 01 00 00 00 00 02 b6 02 /* 111 */
					29 01 00 00 00 00 02 b6 03 /* 105 */
					29 01 00 00 00 00 02 b6 03 /* 98 */
					29 01 00 00 00 00 02 b6 04 /* 92 */
					29 01 00 00 00 00 02 b6 04 /* 88 */
					29 01 00 00 00 00 02 b6 04 /* 82 */
					29 01 00 00 00 00 02 b6 05 /* 77 */
					29 01 00 00 00 00 02 b6 05 /* 72~5 */
				];

			samsung,panel-smart-acl-lowtemp-cmds-list = [
					29 01 00 00 00 00 02 b6 25 /* 350 */
					29 01 00 00 00 00 02 b6 24 /* 333 */
					29 01 00 00 00 00 02 b6 24 /* 316 */
					29 01 00 00 00 00 02 b6 23 /* 300 */
					29 01 00 00 00 00 02 b6 23 /* 282 */
					29 01 00 00 00 00 02 b6 22 /* 265 */
					29 01 00 00 00 00 02 b6 21 /* 249 */
					29 01 00 00 00 00 02 b6 20 /* 234 */
					29 01 00 00 00 00 02 b6 20 /* 220 */
					29 01 00 00 00 00 02 b6 20 /* 207 */
					29 01 00 00 00 00 02 b6 20 /* 195 */
					29 01 00 00 00 00 02 b6 20 /* 183 */
					29 01 00 00 00 00 02 b6 20 /* 172 */
					29 01 00 00 00 00 02 b6 20 /* 162 */
					29 01 00 00 00 00 02 b6 20 /* 152 */
					29 01 00 00 00 00 02 b6 00 /* 143 */
					29 01 00 00 00 00 02 b6 01 /* 134 */
					29 01 00 00 00 00 02 b6 01 /* 126 */
					29 01 00 00 00 00 02 b6 02 /* 119 */
					29 01 00 00 00 00 02 b6 02 /* 111 */
					29 01 00 00 00 00 02 b6 03 /* 105 */
					29 01 00 00 00 00 02 b6 03 /* 98 */
					29 01 00 00 00 00 02 b6 04 /* 92 */
					29 01 00 00 00 00 02 b6 04 /* 88 */
					29 01 00 00 00 00 02 b6 04 /* 82 */
					29 01 00 00 00 00 02 b6 05 /* 77 */
					29 01 00 00 00 00 02 b6 05 /* 72~5 */
				];

			samsung,panel-smart-acl-elvss-map-table = <
					5		26
					6		26
					7		26
					8		26
					9		26
					10		26
					11		26
					12		26
					13		26
					14		26
					15		26
					16		26
					17		26
					19		26
					20		26
					21		26
					22		26
					24		26
					25		26
					27		26
					29		26
					30		26
					32		26
					34		26
					37		26
					39		26
					41		26
					44		26
					47		26
					50		26
					53		26
					56		26
					60		26
					64		26
					68		26
					72		26
					77		25
					82		24
					87		23
					93		22
					98		21
					105		20
					111		19
					119		18
					126		17
					134		16
					143		15
					152		14
					162		13
					172		12
					183		11
					195		10
					207		9
					220		8
					234		7
					249		6
					265		5
					282		4
					300		3
					316		2
					333		1
					350		0
				>;
			/*
			 * ************************************************************************************************************************
			 * candela to index mappings
			 * ************************************************************************************************************************
			 */
			samsung,panel-candella-mapping-table = <
				/*<idx>		<from>		<till>		<candella> */
					0		0		5		5
					1		6		6		6
					2		7		7		7
					3		8		8		8
					4		9		9		9
					5		10		10		10
					6		11		11		11
					7		12		12		12
					8		13		13		13
					9		14		14		14
					10		15		15		15
					11		16		16		16
					12		17		18		17
					13		19		19		19
					14		20		20		20
					15		21		21		21
					16		22		23		22
					17		24		24		24
					18		25		26		25
					19		27		28		27
					20		29		29		29
					21		30		31		30
					22		32		32		32
					23		33		36		34
					24		37		38		37
					25		39		40		39
					26		41		43		41
					27		44		46		44
					28		47		49		47
					29		50		52		50
					30		53		55		53
					31		56		59		56
					32		60		63		60
					33		64		67		64
					34		68		71		68
					35		72		76		72
					36		77		81		77
					37		82		86		82
					38		87		92		87
					39		93		97		93
					40		98		104		98
					41		105		110		105
					42		111		118		111
					43		119		125		119
					44		126		133		126
					45		134		142		134
					46		143		149		143
					47		150		161		152
					48		162		171		162
					49		172		181		172
					50		182		193		183
					51		194		205		195
					52		206		218		207
					53		219		229		220
					54		230		237		234
					55		238		241		249
					56		242		244		265
					57		245		247		282
					58		248		249		300
					59		250		251		316
					60		252		253		333
					61		254		255		350
				>;

	};
};
